## src/drivers/uwb/mk_uwbs/Kconfig
```kconfig
menuconfig DRIVERS_UWB_MK_UWBS
	bool "mk_uwbs"
	default n
	---help---
		Enable support for mk_uwbs
```

## src/examples/autonomous_landing/Kconfig
```kconfig
menuconfig EXAMPLES_AUTONOMOUS_LANDING
	bool "autonomous_landing"
	default n
	---help---
		Enable support for autonomous_landing
```

## src/examples/mk_uwb/Kconfig
```kconfig
menuconfig EXAMPLES_MK_UWB
	bool "mk_uwb"
	default n
	---help---
		Enable support for mk_uwb
```
